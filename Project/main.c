/*******************************************************************************
注意事项：
根据自己使用的LCD1602是否带有转接板，如果带有转接板的即为4位，需在LCD.H头文件中
将宏#define LCD1602_4PINS打开，我们这里使用的LCD1602是8位，所以默认将该宏注释。

单片机与矩阵键盘模块接线说明：
矩阵按键接线参考矩阵按键实验接线图

实验操作：
S1-S4：0-3
S5-S8：4-7
S9-S12：8-B
S13-S16：C-F。
*******************************************************************************/

#include<reg51.h>	
#include"lcd.h"


//用来存放按键状态
unsigned char PuZh[]=" Pechin Science ";
unsigned char dat[]="0123456789ABCDEF";
void Delay10ms();   //延时50us
void KeyDown();		 //检测按键函数
 
/*******************************************************************************
* 函 数 名         : main
* 函数功能		   : 主函数
* 输    入         : 无
* 输    出         : 无
*******************************************************************************/
void main(void)
{
	unsigned char i;
	LcdInit();
	for(i=0;i<16;i++)
	{
//		LcdWriteCom(0x80);
		LcdWriteData(PuZh[i]);	
	}
	while(1)
	{
		if(0)
		{
			LcdWriteCom(0x80+0x40);
			LcdWriteData(dat[0]);
		}
	}				
}

/*******************************************************************************
* 函 数 名         : Delay10ms
* 函数功能		   : 延时函数，延时10ms
* 输    入         : 无
* 输    出         : 无
*******************************************************************************/
void Delay10ms(void)   //误差 0us
{
    unsigned char a,b,c;
    for(c=1;c>0;c--)
        for(b=38;b>0;b--)
            for(a=130;a>0;a--);
}
